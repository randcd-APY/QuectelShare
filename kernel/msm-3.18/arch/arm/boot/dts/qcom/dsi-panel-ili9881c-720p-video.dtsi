/* Copyright (c) 2013, The Linux Foundation. All rights reserved.
 *
 * This program is free software; you can redistribute it and/or modify
 * it under the terms of the GNU General Public License version 2 and
 * only version 2 as published by the Free Software Foundation.
 *
 * This program is distributed in the hope that it will be useful,
 * but WITHOUT ANY WARRANTY; without even the implied warranty of
 * MERCHANTABILITY or FITNESS FOR A PARTICULAR PURPOSE.  See the
 * GNU General Public License for more details.
 */

/*---------------------------------------------------------------------------
 * This file is autogenerated file using gcdb parser. Please do not edit it.
 * Update input XML file to add a new entry or update variable in this file
 * VERSION = "1.0"
 *---------------------------------------------------------------------------*/
&mdss_mdp {
	dsi_ili9881c_720p_video: qcom,mdss_dsi_ili9881c_720p_video {
		qcom,mdss-dsi-panel-name = "ili9881c 720p video mode dsi panel";
		qcom,mdss-dsi-panel-controller = <&mdss_dsi0>;
		qcom,mdss-dsi-panel-type = "dsi_video_mode";
		qcom,mdss-dsi-panel-destination = "display_1";
		qcom,mdss-dsi-panel-framerate = <60>;
		qcom,mdss-dsi-virtual-channel-id = <0>;
		qcom,mdss-dsi-stream = <0>;
		qcom,mdss-dsi-panel-width = <720>;
		qcom,mdss-dsi-panel-height = <1280>;
		qcom,mdss-dsi-h-front-porch = <52>;
		qcom,mdss-dsi-h-back-porch = <100>;
		qcom,mdss-dsi-h-pulse-width = <36>;
		qcom,mdss-dsi-h-sync-skew = <0>;
		qcom,mdss-dsi-v-back-porch = <20>;
		qcom,mdss-dsi-v-front-porch = <8>;
		qcom,mdss-dsi-v-pulse-width = <4>;
		qcom,mdss-dsi-h-left-border = <0>;
		qcom,mdss-dsi-h-right-border = <0>;
		qcom,mdss-dsi-v-top-border = <0>;
		qcom,mdss-dsi-v-bottom-border = <0>;
		qcom,mdss-dsi-bpp = <24>;
		qcom,mdss-dsi-color-order = "rgb_swap_rgb";
		qcom,mdss-dsi-underflow-color = <0xff>;
		qcom,mdss-dsi-border-color = <0>;
		qcom,mdss-dsi-on-command = [39 01 00 00 00 00 04 FF 98 81 03
39 01 00 00 00 00 02 01 00
39 01 00 00 00 00 02 02 00
39 01 00 00 00 00 02 03 73
39 01 00 00 00 00 02 04 03
39 01 00 00 00 00 02 05 00
39 01 00 00 00 00 02 06 06
39 01 00 00 00 00 02 07 06
39 01 00 00 00 00 02 08 00
39 01 00 00 00 00 02 09 18
39 01 00 00 00 00 02 0A 04
39 01 00 00 00 00 02 0B 00
39 01 00 00 00 00 02 0C 02
39 01 00 00 00 00 02 0D 03
39 01 00 00 00 00 02 0E 00
39 01 00 00 00 00 02 0F 25
39 01 00 00 00 00 02 10 25
39 01 00 00 00 00 02 11 00
39 01 00 00 00 00 02 12 00
39 01 00 00 00 00 02 13 00
39 01 00 00 00 00 02 14 00
39 01 00 00 00 00 02 15 00
39 01 00 00 00 00 02 16 0c
39 01 00 00 00 00 02 17 00
39 01 00 00 00 00 02 18 00
39 01 00 00 00 00 02 19 00
39 01 00 00 00 00 02 1A 00
39 01 00 00 00 00 02 1B 00
39 01 00 00 00 00 02 1C 00
39 01 00 00 00 00 02 1D 00
39 01 00 00 00 00 02 1E C0
39 01 00 00 00 00 02 1F 80
39 01 00 00 00 00 02 20 04
39 01 00 00 00 00 02 21 01
39 01 00 00 00 00 02 22 00
39 01 00 00 00 00 02 23 00
39 01 00 00 00 00 02 24 00
39 01 00 00 00 00 02 25 00
39 01 00 00 00 00 02 26 00
39 01 00 00 00 00 02 27 00
39 01 00 00 00 00 02 28 33
39 01 00 00 00 00 02 29 03
39 01 00 00 00 00 02 2A 00
39 01 00 00 00 00 02 2B 00
39 01 00 00 00 00 02 2C 00
39 01 00 00 00 00 02 2D 00
39 01 00 00 00 00 02 2E 00
39 01 00 00 00 00 02 2F 00
39 01 00 00 00 00 02 30 00
39 01 00 00 00 00 02 31 00
39 01 00 00 00 00 02 32 00
39 01 00 00 00 00 02 33 00
39 01 00 00 00 00 02 34 04
39 01 00 00 00 00 02 35 00
39 01 00 00 00 00 02 36 00
39 01 00 00 00 00 02 37 00
39 01 00 00 00 00 02 38 3c
39 01 00 00 00 00 02 39 00
39 01 00 00 00 00 02 3A 00
39 01 00 00 00 00 02 3B 00
39 01 00 00 00 00 02 3C 00
39 01 00 00 00 00 02 3D 00
39 01 00 00 00 00 02 3E 00
39 01 00 00 00 00 02 3F 00
39 01 00 00 00 00 02 40 00
39 01 00 00 00 00 02 41 00
39 01 00 00 00 00 02 42 00
39 01 00 00 00 00 02 43 00
39 01 00 00 00 00 02 44 00
39 01 00 00 00 00 02 50 01
39 01 00 00 00 00 02 51 23
39 01 00 00 00 00 02 52 45
39 01 00 00 00 00 02 53 67
39 01 00 00 00 00 02 54 89
39 01 00 00 00 00 02 55 ab
39 01 00 00 00 00 02 56 01
39 01 00 00 00 00 02 57 23
39 01 00 00 00 00 02 58 45
39 01 00 00 00 00 02 59 67
39 01 00 00 00 00 02 5A 89
39 01 00 00 00 00 02 5B ab
39 01 00 00 00 00 02 5C cd
39 01 00 00 00 00 02 5D ef
39 01 00 00 00 00 02 5E 11
39 01 00 00 00 00 02 5F 02
39 01 00 00 00 00 02 60 02
39 01 00 00 00 00 02 61 02
39 01 00 00 00 00 02 62 02
39 01 00 00 00 00 02 63 02
39 01 00 00 00 00 02 64 02
39 01 00 00 00 00 02 65 02
39 01 00 00 00 00 02 66 02
39 01 00 00 00 00 02 67 02
39 01 00 00 00 00 02 68 02
39 01 00 00 00 00 02 69 02
39 01 00 00 00 00 02 6A 0c
39 01 00 00 00 00 02 6B 02
39 01 00 00 00 00 02 6C 0f
39 01 00 00 00 00 02 6D 0e
39 01 00 00 00 00 02 6E 0d
39 01 00 00 00 00 02 6F 06
39 01 00 00 00 00 02 70 07
39 01 00 00 00 00 02 71 02
39 01 00 00 00 00 02 72 02
39 01 00 00 00 00 02 73 02
39 01 00 00 00 00 02 74 02
39 01 00 00 00 00 02 75 02
39 01 00 00 00 00 02 76 02
39 01 00 00 00 00 02 77 02
39 01 00 00 00 00 02 78 02
39 01 00 00 00 00 02 79 02
39 01 00 00 00 00 02 7A 02
39 01 00 00 00 00 02 7B 02
39 01 00 00 00 00 02 7C 02
39 01 00 00 00 00 02 7D 02
39 01 00 00 00 00 02 7E 02
39 01 00 00 00 00 02 7F 02
39 01 00 00 00 00 02 80 0c
39 01 00 00 00 00 02 81 02
39 01 00 00 00 00 02 82 0f
39 01 00 00 00 00 02 83 0e
39 01 00 00 00 00 02 84 0d
39 01 00 00 00 00 02 85 06
39 01 00 00 00 00 02 86 07
39 01 00 00 00 00 02 87 02
39 01 00 00 00 00 02 88 02
39 01 00 00 00 00 02 89 02
39 01 00 00 00 00 02 8A 02
39 01 00 00 00 00 04 FF 98 81 04
39 01 00 00 00 00 02 6c 15
39 01 00 00 00 00 02 6e 22
39 01 00 00 00 00 02 6f 33
39 01 00 00 00 00 02 3a a4
39 01 00 00 00 00 02 8d 0d
39 01 00 00 00 00 02 87 ba
39 01 00 00 00 00 02 26 76
39 01 00 00 00 00 02 b2 d1
39 01 00 00 00 00 04 FF 98 81 01
39 01 00 00 00 00 02 22 0a
39 01 00 00 00 00 02 53 be
39 01 00 00 00 00 02 55 a7
39 01 00 00 00 00 02 50 74
39 01 00 00 00 00 02 51 74
39 01 00 00 00 00 02 31 02
39 01 00 00 00 00 02 60 14
39 01 00 00 00 00 02 a0 15
39 01 00 00 00 00 02 a1 26
39 01 00 00 00 00 02 a2 2b
39 01 00 00 00 00 02 a3 14
39 01 00 00 00 00 02 a4 17
39 01 00 00 00 00 02 a5 2c
39 01 00 00 00 00 02 a6 20
39 01 00 00 00 00 02 a7 21
39 01 00 00 00 00 02 a8 95
39 01 00 00 00 00 02 a9 1d
39 01 00 00 00 00 02 aa 27
39 01 00 00 00 00 02 ab 89
39 01 00 00 00 00 02 ac 1a
39 01 00 00 00 00 02 ad 18
39 01 00 00 00 00 02 ae 4b
39 01 00 00 00 00 02 af 21
39 01 00 00 00 00 02 b0 26
39 01 00 00 00 00 02 b1 60
39 01 00 00 00 00 02 b2 71
39 01 00 00 00 00 02 b3 3f
39 01 00 00 00 00 02 c0 05
39 01 00 00 00 00 02 c1 26
39 01 00 00 00 00 02 c2 3f
39 01 00 00 00 00 02 c3 0f
39 01 00 00 00 00 02 c4 14
39 01 00 00 00 00 02 c5 27
39 01 00 00 00 00 02 c6 1a
39 01 00 00 00 00 02 c7 1e
39 01 00 00 00 00 02 c8 9e
39 01 00 00 00 00 02 c9 1a
39 01 00 00 00 00 02 ca 29
39 01 00 00 00 00 02 cb 82
39 01 00 00 00 00 02 cc 18
39 01 00 00 00 00 02 cd 16
39 01 00 00 00 00 02 ce 4c
39 01 00 00 00 00 02 cf 1f
39 01 00 00 00 00 02 d0 28
39 01 00 00 00 00 02 d1 53
39 01 00 00 00 00 02 d2 62
39 01 00 00 00 00 02 d3 3f
39 01 00 00 00 00 04 FF 98 81 00
05 01 00 00 78 00 02 11 00
05 01 00 00 0A 00 02 29 00
39 01 00 00 00 00 02 35 00];
		qcom,mdss-dsi-off-command = [05 01 00 00 32 00 02 28 00
					05 01 00 00 78 00 02 10 00];
		qcom,mdss-dsi-on-command-state = "dsi_lp_mode";
		qcom,mdss-dsi-off-command-state = "dsi_hs_mode";
		qcom,mdss-dsi-h-sync-pulse = <1>;
		qcom,mdss-dsi-traffic-mode = "burst_mode";
		qcom,mdss-dsi-lane-map = "lane_map_0123";
		qcom,mdss-dsi-bllp-eof-power-mode;
		qcom,mdss-dsi-bllp-power-mode;
		qcom,mdss-dsi-lane-0-state;
		qcom,mdss-dsi-lane-1-state;
		qcom,mdss-dsi-lane-2-state;
		qcom,mdss-dsi-lane-3-state;
		qcom,mdss-dsi-panel-timings = [7a 1a 12 00 3e 42 16 1e 14 03 04 00];
		qcom,mdss-dsi-t-clk-post = <0x0A>;
		qcom,mdss-dsi-t-clk-pre = <0x1D>;
		qcom,mdss-dsi-bl-min-level = <1>;
		qcom,mdss-dsi-bl-max-level = <4095>;
		qcom,mdss-dsi-dma-trigger = "trigger_sw";
		qcom,mdss-dsi-mdp-trigger = "none";
		qcom,mdss-dsi-bl-pmic-control-type = "bl_ctrl_pwm";
		qcom,mdss-dsi-reset-sequence = <1 20>, <0 2>, <1 20>;
        qcom,mdss-dsi-post-init-delay = <4>;
        qcom,mdss-pan-physical-width-dimension = <59>;
        qcom,mdss-pan-physical-height-dimension = <104>;
	};
};
