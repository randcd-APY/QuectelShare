## poky/meta-allplay-prop/conf/distro/msm.conf
```bitbake
require ${COREBASE}/meta-qti-bsp/conf/distro/msm.conf

FULL_OPTIMIZATION += "-g"
```

## poky/meta-allplay-prop/conf/layer.conf
```bitbake
# We have a conf and classes directory, append to BBPATH
BBPATH .= ":${LAYERDIR}"

# We have a recipes directory, add to BBFILES
BBFILES += "${LAYERDIR}/recipes*/*/*.bb ${LAYERDIR}/recipes*/*/*.bbappend"

BBFILE_COLLECTIONS += "allplayprop"
BBFILE_PATTERN_allplayprop := "^${LAYERDIR}/"

# qcom = qti-bsp-prop
# qsap-prop = qti-qsap-prop (for websetup et al)
LAYERDEPENDS_allplayprop = "allplay qcom qsap-prop"
```

## poky/meta-allplay-prop/conf/machine/apq8017.conf
```bitbake
#@TYPE: Machine
#@NAME: APQ8017
#@DESCRIPTION: Machine configuration for QTI APQ8017

require ${COREBASE}/meta-qti-bsp-prop/conf/machine/apq8017.conf

KERNEL_CMD_PARAMS += "slub_debug=-"
```

## poky/meta-allplay/conf/layer.conf
```bitbake
# We have a conf and classes directory, append to BBPATH
BBPATH .= ":${LAYERDIR}"

# We have a recipes directory, add to BBFILES
BBFILES += "${LAYERDIR}/recipes*/*/*.bb ${LAYERDIR}/recipes*/*/*.bbappend"

BBFILE_COLLECTIONS += "allplay"
BBFILE_PATTERN_allplay := "^${LAYERDIR}/"

# msm = meta-qti-bsp
# qsap = meta-qti-qsap
LAYERDEPENDS_allplay = "msm qsap"
```

## poky/meta-ffmpeg-video/conf/layer.conf
```bitbake
# We have a conf and classes directory, add to BBPATH
BBPATH .= ":${LAYERDIR}"

# We have recipes-* directories, add to BBFILES
BBFILES += "${LAYERDIR}/recipes/*/*.bb ${LAYERDIR}/recipes/*/*.bbappend ${LAYERDIR}/recipes-*/*/*.bb ${LAYERDIR}/recipes-products/images/*.bbappend"

BBFILE_COLLECTIONS += "meta-ffmpeg-video"
BBFILE_PATTERN_meta-ffmpeg-video = "^${LAYERDIR}/"
BBFILE_PRIORITY_meta-ffmpeg-video = "6"
```

## poky/meta-qti-audio-cal/conf/layer.conf
```bitbake
BBFILES += "${LAYERDIR}/recipes/*/*.bb ${LAYERDIR}/recipes/*/*.bbappend ${LAYERDIR}/recipes-*/*/*.bb ${LAYERDIR}/recipes-*/*/*.bbappend"
BBPATH .= ":${LAYERDIR}"
BBFILE_COLLECTIONS += "audio-cal"
BBFILE_PRIORITY_audio-cal = "17"
BBFILE_PATTERN_audio-cal := "^${LAYERDIR}/"
```

## poky/meta-qti-audio-external/conf/layer.conf
```bitbake
BBFILES += "${LAYERDIR}/recipes/*/*.bb ${LAYERDIR}/recipes/*/*.bbappend ${LAYERDIR}/recipes-*/*/*.bb ${LAYERDIR}/recipes-*/*/*.bbappend"
BBPATH .= ":${LAYERDIR}"
BBFILE_COLLECTIONS += "audio-external"
BBFILE_PRIORITY_audio-external = "17"
BBFILE_PATTERN_audio-external := "^${LAYERDIR}/"
```

## poky/meta-qti-audio-prop/conf/layer.conf
```bitbake
BBFILES += "${LAYERDIR}/recipes/*/*.bb ${LAYERDIR}/recipes/*/*.bbappend ${LAYERDIR}/recipes-*/*/*.bb ${LAYERDIR}/recipes-*/*/*.bbappend"
BBPATH .= ":${LAYERDIR}"
BBFILE_COLLECTIONS += "audio-prop"
BBFILE_PRIORITY_audio-prop = "17"
BBFILE_PATTERN_audio-prop := "^${LAYERDIR}/"
```

## poky/meta-qti-avs-prop/conf/layer.conf
```bitbake
BBFILES += "${LAYERDIR}/recipes/*/*.bb ${LAYERDIR}/recipes/*/*.bbappend ${LAYERDIR}/recipes-*/*/*.bb ${LAYERDIR}/recipes-*/*/*.bbappend"
BBPATH .= ":${LAYERDIR}"
BBFILE_COLLECTIONS += "avs-prop"
BBFILE_PRIORITY_avs-prop = "17"
BBFILE_PATTERN_avs-prop := "^${LAYERDIR}/"
LAYERDEPENDS_avs-prop = "gst-prop"
```

## poky/meta-qti-avs/conf/layer.conf
```bitbake
BBFILES += "${LAYERDIR}/recipes/*/*.bb ${LAYERDIR}/recipes/*/*.bbappend ${LAYERDIR}/recipes-*/*/*.bb ${LAYERDIR}/recipes-*/*/*.bbappend"
BBPATH .= ":${LAYERDIR}"
BBFILE_COLLECTIONS += "avs"
BBFILE_PATTERN_avs := "^${LAYERDIR}/"

# msm = meta-qti-bsp
LAYERDEPENDS_avs = "msm"
```

## poky/meta-qti-bsp-prop/conf/distro/include/security_flags.inc
```bitbake
# PACKAGES to use -fPIC in security flags instead of -fPIE
# GPS Prop packages
SECURITY_CFLAGS_pn-asn1c-cper = "${SECURITY_PIC_CFLAGS}"
SECURITY_CFLAGS_pn-asn1c-crt = "${SECURITY_PIC_CFLAGS}"
SECURITY_CFLAGS_pn-asn1c-rtx = "${SECURITY_PIC_CFLAGS}"
SECURITY_CFLAGS_pn-data-items  = "${SECURITY_PIC_CFLAGS}"
SECURITY_CFLAGS_pn-dr-ap-service  = "${SECURITY_PIC_CFLAGS}"
SECURITY_CFLAGS_pn-drplugin = "${SECURITY_PIC_CFLAGS}"
SECURITY_CFLAGS_pn-drplugin-client = "${SECURITY_PIC_CFLAGS}"
SECURITY_CFLAGS_pn-drplugin-server = "${SECURITY_PIC_CFLAGS}"
SECURITY_CFLAGS_pn-event-observer = "${SECURITY_PIC_CFLAGS}"
SECURITY_CFLAGS_pn-garden-app = "${SECURITY_PIC_CFLAGS}"
SECURITY_CFLAGS_pn-garden-test-interfaces = "${SECURITY_PIC_CFLAGS}"
SECURITY_CFLAGS_pn-gdtap-adapter = "${SECURITY_PIC_CFLAGS}"
SECURITY_CFLAGS_pn-gnsspps = "${SECURITY_PIC_CFLAGS}"
SECURITY_CFLAGS_pn-gtp-ap-le-os-agent = "${SECURITY_PIC_CFLAGS}"
SECURITY_CFLAGS_pn-izat-client-api = "${SECURITY_PIC_CFLAGS}"
SECURITY_CFLAGS_pn-izat-core = "${SECURITY_PIC_CFLAGS}"
SECURITY_CFLAGS_pn-lbs-core = "${SECURITY_PIC_CFLAGS}"
SECURITY_CFLAGS_pn-location-flp = "${SECURITY_PIC_CFLAGS}"
SECURITY_CFLAGS_pn-location-geofence = "${SECURITY_PIC_CFLAGS}"
SECURITY_CFLAGS_pn-location-service  = "${SECURITY_PIC_CFLAGS}"
SECURITY_CFLAGS_pn-loc-base-util = "${SECURITY_PIC_CFLAGS}"
SECURITY_CFLAGS_pn-loc-externaldr = "${SECURITY_PIC_CFLAGS}"
SECURITY_CFLAGS_pn-loc-externaldrcore = "${SECURITY_PIC_CFLAGS}"
SECURITY_CFLAGS_pn-loc-glue  = "${SECURITY_PIC_CFLAGS}"
SECURITY_CFLAGS_pn-loc-launcher = "${SECURITY_PIC_CFLAGS}"
SECURITY_CFLAGS_pn-loc-mq-client = "${SECURITY_PIC_CFLAGS}"
SECURITY_CFLAGS_pn-lowi-client  = "${SECURITY_PIC_CFLAGS}"
SECURITY_CFLAGS_pn-lowi-common  = "${SECURITY_PIC_CFLAGS}"
SECURITY_CFLAGS_pn-lowi-server  = "${SECURITY_PIC_CFLAGS}"
SECURITY_CFLAGS_pn-lowi-test  = "${SECURITY_PIC_CFLAGS}"
SECURITY_CFLAGS_pn-nmea-test-app  = "${SECURITY_PIC_CFLAGS}"
SECURITY_CFLAGS_pn-slim-client  = "${SECURITY_PIC_CFLAGS}"
SECURITY_CFLAGS_pn-slim-common  = "${SECURITY_PIC_CFLAGS}"
SECURITY_CFLAGS_pn-slim-daemon  = "${SECURITY_PIC_CFLAGS}"
SECURITY_CFLAGS_pn-slim-utils  = "${SECURITY_PIC_CFLAGS}"
SECURITY_CFLAGS_pn-ulp2  = "${SECURITY_PIC_CFLAGS}"
SECURITY_CFLAGS_pn-xtwifi-client  = "${SECURITY_PIC_CFLAGS}"
SECURITY_CFLAGS_pn-xtwifi-inet-agent  = "${SECURITY_PIC_CFLAGS}"
SECURITY_CFLAGS_pn-loc-mcm-test-shim  = "${SECURITY_PIC_CFLAGS}"
SECURITY_CFLAGS_pn-loc-mcm-type-conv  = "${SECURITY_PIC_CFLAGS}"
SECURITY_CFLAGS_pn-mcmlocserver  = "${SECURITY_PIC_CFLAGS}"
SECURITY_CFLAGS_pn-loc-eng-hub  = "${SECURITY_PIC_CFLAGS}"
SECURITY_CFLAGS_pn-loc-glue  = "${SECURITY_PIC_CFLAGS}"
SECURITY_CFLAGS_pn-loc-hal-test-shim  = "${SECURITY_PIC_CFLAGS}"
SECURITY_CFLAGS_pn-location-service  = "${SECURITY_PIC_CFLAGS}"
SECURITY_CFLAGS_pn-data-items  = "${SECURITY_PIC_CFLAGS}"
SECURITY_CFLAGS_pn-izat-remote-api-test  = "${SECURITY_PIC_CFLAGS}"
SECURITY_CFLAGS_pn-engine-plugin  = "${SECURITY_PIC_CFLAGS}"
SECURITY_CFLAGS_pn-location-client-api  = "${SECURITY_PIC_CFLAGS}"
SECURITY_CFLAGS_pn-engine-simulator  = "${SECURITY_PIC_CFLAGS}"
SECURITY_CFLAGS_pn-loc-epdr = "${SECURITY_PIC_CFLAGS}"
SECURITY_CFLAGS_pn-telephony-library = "${SECURITY_PIC_CFLAGS}"

# BT prop packages
SECURITY_CFLAGS_pn-hci-qcomm-init = "${SECURITY_PIC_CFLAGS}"
SECURITY_CFLAGS_pn-qc-bt-daemon = "${SECURITY_PIC_CFLAGS}"

SECURITY_CFLAGS_pn-data = "${SECURITY_PIC_CFLAGS}"
SECURITY_CFLAGS_pn-display-noship = "${SECURITY_PIC_CFLAGS}"
SECURITY_CFLAGS_pn-scve-noship = "${SECURITY_PIC_CFLAGS}"
SECURITY_CFLAGS_pn-lib32-scve-noship = "${SECURITY_PIC_CFLAGS}"

# Camera packages
SECURITY_CFLAGS_pn-camx = "${SECURITY_PIC_CFLAGS}"
SECURITY_CFLAGS_pn-chicdk = "${SECURITY_PIC_CFLAGS}"
SECURITY_CFLAGS_pn-chicdkgenerator = "${SECURITY_PIC_CFLAGS}"

#
### PACKAGES which can't compile with security format strings check
#
SECURITY_CFLAGS_remove_pn-data      = "${SECURITY_STRINGFORMAT}"
SECURITY_CFLAGS_remove_pn-mcm-core  = "${SECURITY_STRINGFORMAT}"
SECURITY_CFLAGS_remove_pn-camx      = "${SECURITY_STRINGFORMAT}"
SECURITY_CFLAGS_remove_pn-chicdk    = "${SECURITY_STRINGFORMAT}"
SECURITY_CFLAGS_remove_pn-chicdkgenerator = "${SECURITY_STRINGFORMAT}"

#
### PACKAGES which can't compile with stack-protector
#
SECURITY_CFLAGS_remove_pn-adreno = "-fstack-protector-strong"

#
### PACKAGES which can't compile with _FORTIFY_SOURCE
#
SECURITY_CFLAGS_remove_pn-qcacld-utils= "-D_FORTIFY_SOURCE=2"
```

## poky/meta-qti-bsp-prop/conf/distro/qpermissions-prop.conf
```bitbake
QPERM_FILE_pn-rmtstorage = "/sbin/rmt_storage:nobody:system"
QPERM_FILE_pn-sensors-see = "/usr/bin/sensors.qti:sensors:sensors"
```

## poky/meta-qti-bsp-prop/conf/layer.conf
```bitbake
BBFILES += "${LAYERDIR}/recipes/*/*.bb ${LAYERDIR}/recipes/*/*.bbappend ${LAYERDIR}/recipes-*/*/*.bb ${LAYERDIR}/recipes-*/*/*.bbappend"
BBPATH .= ":${LAYERDIR}"
BBFILE_COLLECTIONS += "qcom"
BBFILE_PRIORITY_qcom = "15"
BBFILE_PATTERN_qcom := "^${LAYERDIR}/"
LICENSE_PATH += "${LAYERDIR}/files/qcom-licenses"
```

## poky/meta-qti-bsp-prop/conf/machine/apq8017.conf
```bitbake
#@TYPE: Machine
#@NAME: APQ8017
#@DESCRIPTION: Machine configuration for QTI APQ8017

require ${COREBASE}/meta-qti-bsp/conf/machine/apq8017.conf

# Pull in the security flags overrides for prop packages
require ${COREBASE}/meta-qti-bsp-prop/conf/distro/include/security_flags.inc
```

## poky/meta-qti-bsp-prop/conf/machine/apq8053-32.conf
```bitbake
#@TYPE: Machine
#@NAME: APQ8053-32
#@DESCRIPTION: Machine configuration for QTI APQ8053 32 bit

require ${COREBASE}/meta-qti-bsp/conf/machine/apq8053-32.conf

# Pull in the security flags overrides for prop packages
require ${COREBASE}/meta-qti-bsp-prop/conf/distro/include/security_flags.inc

USRFS_FSCONFIG = "-C ${WORKDIR}/usrfs_fsconfig.conf"
PERSISTFS_CONFIG = "-C ${WORKDIR}/persist_fsconfig.conf"
MAKEEXT4_MOUNT_OPT = "-a /"

# Use sdllvm to compile some of the qti packages
LLVM_VERSION = "3.8"
INHERIT += "sdllvm"
require ${COREBASE}/meta-qti-bsp-prop/conf/machine/apq8053/sdllvmpkgs.conf

# Whitelist packages having commercial license.
LICENSE_FLAGS_WHITELIST  += "commercial_ffmpeg"
```

## poky/meta-qti-bsp-prop/conf/machine/apq8053/sdllvmpkgs.conf
```bitbake
# List of pkgs to be built with sdllvm.

TOOLCHAIN_pn-libcutils  = "sdllvm"
TOOLCHAIN_pn-liblog     = "sdllvm"
TOOLCHAIN_pn-libui      = "sdllvm"
TOOLCHAIN_pn-camera     = "sdllvm"
TOOLCHAIN_pn-cameradbg  = "sdllvm"
TOOLCHAIN_pn-mm-3a-core = "sdllvm"
TOOLCHAIN_pn-mm-camera  = "sdllvm"
TOOLCHAIN_pn-mm-camerasdk     = "sdllvm"
TOOLCHAIN_pn-mm-camera-core   = "sdllvm"
TOOLCHAIN_pn-mm-camera-lib    = "sdllvm"
TOOLCHAIN_pn-mm-camera-noship = "sdllvm"
TOOLCHAIN_pn-mm-still         = "sdllvm"
TOOLCHAIN_pn-fastcv-noship    = "sdllvm"
TOOLCHAIN_pn-scve-noship      = "sdllvm"
TOOLCHAIN_pn-qmmf-sdk         = "sdllvm"
TOOLCHAIN_pn-media            = "sdllvm"
TOOLCHAIN_pn-mm-video-noship  = "sdllvm"
TOOLCHAIN_pn-mm-parser        = "sdllvm"
TOOLCHAIN_pn-mm-parser-noship = "sdllvm"
TOOLCHAIN_pn-mm-osal          = "sdllvm"
TOOLCHAIN_pn-mm-video-utils   = "sdllvm"
TOOLCHAIN_pn-vpp              = "sdllvm"
TOOLCHAIN_pn-vpp-noship       = "sdllvm"
```

## poky/meta-qti-bsp-prop/conf/machine/apq8096.conf
```bitbake
#@TYPE: Machine
#@NAME: APQ8096
#@DESCRIPTION: Machine configuration for QTI APQ8096

require ${COREBASE}/meta-qti-bsp/conf/machine/apq8096.conf

# Pull in the security flags overrides for prop packages
require ${COREBASE}/meta-qti-bsp-prop/conf/distro/include/security_flags.inc

# Whitelist packages having commercial license.
LICENSE_FLAGS_WHITELIST  += "commercial_ffmpeg"
```

## poky/meta-qti-bsp-prop/conf/machine/apq8098.conf
```bitbake
#@TYPE: Machine
#@NAME: APQ8098
#@DESCRIPTION: Machine configuration for QTI APQ8098

require ${COREBASE}/meta-qti-bsp/conf/machine/apq8098.conf

# Pull in the security flags overrides for prop packages
require ${COREBASE}/meta-qti-bsp-prop/conf/distro/include/security_flags.inc

# Whitelist packages having commercial license.
LICENSE_FLAGS_WHITELIST  += "commercial_ffmpeg"
```

## poky/meta-qti-bsp-prop/conf/machine/genericarmv8-64.conf
```bitbake
#@TYPE: Machine
#@NAME: GENERICARMv8-64
#@DESCRIPTION: Machine configuration for QTI GENERICARMv8-64

require ${COREBASE}/meta-qti-bsp/conf/machine/genericarmv8-64.conf

# Pull in the security flags overrides for prop packages
require ${COREBASE}/meta-qti-bsp-prop/conf/distro/include/security_flags.inc

#USRFS_FSCONFIG = "-C ${WORKDIR}/usrfs_fsconfig.conf"
#PERSISTFS_CONFIG = "-C ${WORKDIR}/persist_fsconfig.conf"
#MAKEEXT4_MOUNT_OPT = "-a /"

# Whitelist packages having commercial license.
LICENSE_FLAGS_WHITELIST  += "commercial_ffmpeg"
LICENSE_FLAGS_WHITELIST  += "commercial_x264"
```

## poky/meta-qti-bsp-prop/conf/machine/mdm9607.conf
```bitbake
#@TYPE: Machine
#@NAME: MDM9607 CDP
#@DESCRIPTION: Machine configuration for QTI MDM9607 CDP

require ${COREBASE}/meta-qti-bsp/conf/machine/mdm9607.conf

# Pull in security flags
require ${COREBASE}/meta-qti-bsp-prop/conf/distro/include/security_flags.inc

# Whitelist packages having commercial license.
LICENSE_FLAGS_WHITELIST  += "commercial_ffmpeg"
#QWES feature support
DISTRO_FEATURES += "qwesd"
```

## poky/meta-qti-bsp-prop/conf/machine/mdm9650.conf
```bitbake
#@TYPE: Machine
#@NAME: MDMCALIFORNIUM
#@DESCRIPTION: Machine configuration for QTI MDMCALIFORNIUM

require ${COREBASE}/meta-qti-bsp/conf/machine/mdm9650.conf

# Pull in the security flags overrides for prop packages
require ${COREBASE}/meta-qti-bsp-prop/conf/distro/include/security_flags.inc
```

## poky/meta-qti-bsp-prop/conf/machine/qcs405-som1.conf
```bitbake
#@TYPE: Machine
#@NAME: QCS405
#@DESCRIPTION: Machine configuration for QCS405

require ${COREBASE}/meta-qti-bsp/conf/machine/qcs405-som1.conf

# Pull in the security flags overrides for prop packages
require ${COREBASE}/meta-qti-bsp-prop/conf/distro/include/security_flags.inc

# Use sdllvm to compile some of the qti packages
INHERIT += "sdllvm"
LLVM_VERSION = "6.0"
require ${COREBASE}/meta-qti-bsp-prop/conf/machine/qcs40x/sdllvmpkgs.conf

USERADDEXTENSION = "qpermissions-prop"
```

## poky/meta-qti-bsp-prop/conf/machine/qcs40x/sdllvmpkgs.conf
```bitbake
# List of pkgs to be built with sdllvm.

TOOLCHAIN_pn-fastcv-noship    = "sdllvm"
TOOLCHAIN_pn-scve-noship      = "sdllvm"
```

## poky/meta-qti-bsp-prop/conf/machine/qcs605-32.conf
```bitbake
#@TYPE: Machine
#@NAME: QCS605 32bit
#@DESCRIPTION: Machine configuration for QCS605 32bit

require ${COREBASE}/meta-qti-bsp/conf/machine/qcs605-32.conf

# Pull in the security flags overrides for prop packages
require ${COREBASE}/meta-qti-bsp-prop/conf/distro/include/security_flags.inc

# Whitelist packages having commercial license.
LICENSE_FLAGS_WHITELIST  += "commercial_ffmpeg"

# Use sdllvm to compile some of the qti packages
INHERIT += "sdllvm"
LLVM_VERSION = "4.0"
require ${COREBASE}/meta-qti-bsp-prop/conf/machine/qcs605/sdllvmpkgs.conf

USERADDEXTENSION = "qpermissions-prop"
```

## poky/meta-qti-bsp-prop/conf/machine/qcs605-64.conf
```bitbake
#@TYPE: Machine
#@NAME: QCS605-64
#@DESCRIPTION: Machine configuration for QCS605 64bit

require ${COREBASE}/meta-qti-bsp/conf/machine/qcs605-64.conf

# Pull in the security flags overrides for prop packages
require ${COREBASE}/meta-qti-bsp-prop/conf/distro/include/security_flags.inc

# Whitelist packages having commercial license.
LICENSE_FLAGS_WHITELIST  += "commercial_ffmpeg commercial_lib32-ffmpeg"

# Use sdllvm to compile some of the qti packages
INHERIT += "sdllvm"
LLVM_VERSION = "4.0"
require ${COREBASE}/meta-qti-bsp-prop/conf/machine/qcs605/sdllvmpkgs.conf

USERADDEXTENSION = "qpermissions-prop"
```
