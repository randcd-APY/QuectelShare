## poky/meta-qti-bsp-prop/conf/machine/qcs605/sdllvmpkgs.conf
```bitbake
# List of pkgs to be built with sdllvm.

TOOLCHAIN_pn-fastcv-noship    = "sdllvm"
TOOLCHAIN_pn-scve-noship      = "sdllvm"
TOOLCHAIN_pn-qmmf-sdk         = "sdllvm"
TOOLCHAIN_pn-camxlib          = "sdllvm"
TOOLCHAIN_pn-camx             = "sdllvm"
TOOLCHAIN_pn-chicdk           = "sdllvm"
```

## poky/meta-qti-bsp-prop/conf/machine/sdm-generic32.conf
```bitbake
#@TYPE: Machine
#@NAME: SDM-GENERIC 32bit
#@DESCRIPTION: Machine configuration for sdm-generic 32bit

require ${COREBASE}/meta-qti-bsp/conf/machine/sdm-generic32.conf

# Pull in the security flags overrides for prop packages
require ${COREBASE}/meta-qti-bsp-prop/conf/distro/include/security_flags.inc
```

## poky/meta-qti-bsp-prop/conf/machine/sdm-generic64.conf
```bitbake
#@TYPE: Machine
#@NAME: SDM-GENERIC 64 bit
#@DESCRIPTION: Machine configuration for sdm-generic 64 bit

require ${COREBASE}/meta-qti-bsp/conf/machine/sdm-generic64.conf

# Pull in the security flags overrides for prop packages
require ${COREBASE}/meta-qti-bsp-prop/conf/distro/include/security_flags.inc
```

## poky/meta-qti-bsp-prop/conf/machine/sdx20.conf
```bitbake
#@TYPE: Machine
#@NAME: SDX20
#@DESCRIPTION: Machine configuration for QTI SDX20

require ${COREBASE}/meta-qti-bsp/conf/machine/sdx20.conf

# Pull in the security flags overrides for prop packages
require ${COREBASE}/meta-qti-bsp-prop/conf/distro/include/security_flags.inc
```

## poky/meta-qti-bsp-prop/conf/machine/sdxpoorwills.conf
```bitbake
#@TYPE: Machine
#@NAME: SDXPOORWILLS
#@DESCRIPTION: Machine configuration for QTI sdxpoorwills

require ${COREBASE}/meta-qti-bsp/conf/machine/sdxpoorwills.conf

# Pull in the security flags overrides for prop packages
require ${COREBASE}/meta-qti-bsp-prop/conf/distro/include/security_flags.inc

# Whitelist packages having commercial license.
LICENSE_FLAGS_WHITELIST  += "commercial_ffmpeg"
```

## poky/meta-qti-bsp/conf/distro/auto.conf
```bitbake
BASEDISTRO ?= "mdm"

require conf/distro/mdm.conf

DISTRO_NAME = "auto"
DISTROOVERRIDES =. "auto:"

PRODUCT = "auto"

KERNEL_CONFIG = "${@['sdxpoorwills-auto-perf_defconfig', 'sdxpoorwills-auto_defconfig'][d.getVar('VARIANT', True) == ('' or 'debug')]}"

DISTRO_FEATURES += " selinux"
DISTRO_FEATURES_FILTER_NATIVE  += " selinux"
DEFAULT_ENFORCING = "enforcing"

# Formats of root filesystem images.
IMAGE_FSTYPES = "ubi"
```

## poky/meta-qti-bsp/conf/distro/mdm.conf
```bitbake
#############################################################################
#@TYPE: Distribution
#@NAME: MDM
#@DESCRIPTION: QTI Linux Distribution for MDM targets (glibc based)
#############################################################################
require conf/distro/include/base.inc

# DISTRO CONFIGURATION
DISTRO_NAME = "mdm"
DISTRO_VERSION = "${BUILDNAME}"
VIRTUAL-RUNTIME_dev_manager ?= "busybox-mdev"

# Add distro overrides
DISTROOVERRIDES =. "mdm:"

# Basic distribution features
DISTRO_FEATURES += "sysvinit eabi ipv6 ipv4 largefile thumb-interwork xattr ld-is-gold ${DISTRO_FEATURES_LIBC}"

# MDMs are nand based targets
DISTRO_FEATURES += "nand-boot"

#Enable for Read only system
DISTRO_FEATURES += "ro-rootfs"

# Enable performance features
PERF_BUILD = "${@['0', '1'][d.getVar('VARIANT', True) != ('' or 'debug')]}"
```

## poky/meta-qti-bsp/conf/distro/qpermissions.conf
```bitbake
USERADD_PACKAGES ?= "${PN}"

USERADD_PARAM_${PN} ?= 	" \
			-u 5002 -U leprop; \
			-u 1000 -U system; \
			-u 1001 -U radio; \
			-G leprop -u 1002 -U bluetooth; \
			-u 1003 -U graphics; \
			-u 1004 -g input input; \
			-u 1005 -g audio audio; \
			-G inet,system,leprop -u 1006 -U camera; \
			-u 1010 -U wifi; \
			-u 1013 -U media; \
			-u 1036 -U logd; \
			-u 2000 -U adb; \
			-G diag,inet,system,leprop -u 3011 -U sensors; \
			-u 4000 -U apps; \
			-u 9999 -U nobody; \
			-G system,leprop -u 5000 -U qmmfsvr; \
			-G system,inet,leprop -u 5001 -U qmmfwebsvr; \
			-u 4021 -U locclient; \
			-G system,locclient -u 1021 -U gps; \
			"

GROUPADD_PARAM_${PN} ?=	" \
			-g 3005 net_admin; \
			-g 3009 readproc; \
			-g 3010 wakelock; \
			-g 3012 powermgr; \
			-g 3013 qwes; \
			"
```

## poky/meta-qti-bsp/conf/distro/qsap.conf
```bitbake
BASEDISTRO ?= "msm"
require conf/distro/msm.conf

DISTRO_NAME = "qsap"
DISTROOVERRIDES =. "qsap:"

PRODUCT = "qsap"
```

## poky/meta-qti-bsp/conf/distro/quec-smart.conf
```bitbake
BASEDISTRO ?= "msm"
require conf/distro/msm.conf
DISTRO_NAME = "quec-smart"
DISTROOVERRIDES =. "quec-smart:"

PRODUCT = "quec-smart"

KERNEL_DTS_NAME = "*8*09"

KERNEL_CMD_PARAMS = "noinitrd console=ttyHSL0,115200,n8 androidboot.hardware=qcom ehci-hcd.park=3 msm_rtb.filter=0x37 lpm_levels.sleep_disabled=1 rootwait androidboot.bootdevice=7824900.sdhci"

LICENSE_FILE_WHITELIST += "Apache-2.0"

KERNEL_CMD_PARAMS_remove = "${@bb.utils.contains_any('VARIANT', 'perf user', 'console=ttyHSL0,115200,n8', '', d)}"

PREFERRED_VERSION_linux-msm = "3.18"

# enable audio as a loadable kernel module
DISTRO_FEATURES_append = " audio-dlkm"
DISTRO_FEATURES_append = " virtualization"
DISTRO_FEATURES_append = " pam"
DISTRO_FEATURES_remove = " aufs"

SERIAL_CONSOLE = "${@['115200 ttyHSL0', ''][d.getVar('VARIANT', True) == ('perf')]}"

#DISTRO_FEATURES_append = " ab-boot-support"
```

## poky/meta-qti-bsp/conf/distro/robot-pronto.conf
```bitbake
BASEDISTRO ?= "quec-smart"
require conf/distro/quec-smart.conf

DISTRO_NAME = "robot-pronto"
DISTROOVERRIDES =. "robot-pronto:"

PRODUCT = "quec-smart"
```

## poky/meta-qti-bsp/conf/distro/robot-rome.conf
```bitbake
BASEDISTRO ?= "quec-smart"
require conf/distro/quec-smart.conf

DISTRO_NAME = "robot-rome"
DISTROOVERRIDES =. "robot-rome:"

PRODUCT = "quec-smart"
```

## poky/meta-qti-bsp/conf/distro/robot-som-ros.conf
```bitbake
BASEDISTRO ?= "quec-smart"
require conf/distro/quec-smart.conf
DISTRO_NAME = "quec-smart-ros"
DISTROOVERRIDES =. "quec-smart-ros:"

PRODUCT = "quec-smart"

#Ros needs larger system size
SYSTEM_SIZE_EXT4 = "998860800"
RECOVERY_IMAGE = "0"

PREFERRED_VERSION_v4l-utils = "1.6.2"

KERNEL_DTS_NAME = "*8*09"

KERNEL_CMD_PARAMS = "noinitrd ro console=ttyMSM0,115200,n8 androidboot.hardware=qcom ehci-hcd.park=3 msm_rtb.filter=0x37 lpm_levels.sleep_disabled=1 rootwait androidboot.bootdevice=7824900.sdhci mem=512M"

PREFERRED_VERSION_linux-msm = "4.9"

SERIAL_CONSOLE = "115200 ttyMSM0"
```

## poky/meta-qti-bsp/conf/distro/robot-som.conf
```bitbake
BASEDISTRO ?= "msm"
require conf/distro/msm.conf
DISTRO_NAME = "quec-smart"
DISTROOVERRIDES =. "quec-smart:"

PRODUCT = "quec-smart"

KERNEL_DTS_NAME = "*8*09"

KERNEL_CMD_PARAMS = "noinitrd ro console=ttyHSL0,115200,n8 androidboot.hardware=qcom ehci-hcd.park=3 msm_rtb.filter=0x37 lpm_levels.sleep_disabled=1 rootwait androidboot.bootdevice=7824900.sdhci mem=512M"

KERNEL_CMD_PARAMS_remove = "${@bb.utils.contains_any('VARIANT', 'perf user', 'console=ttyHSL0,115200,n8', '', d)}"

PREFERRED_VERSION_linux-msm = "3.18"

# enable audio as a loadable kernel module
DISTRO_FEATURES_append = " audio-dlkm"

SERIAL_CONSOLE = "${@['115200 ttyHSL0', ''][d.getVar('VARIANT', True) == ('perf')]}"

DISTRO_FEATURES_append = " ab-boot-support"
```

## poky/meta-qti-bsp/conf/layer.conf
```bitbake
BBFILES += "${LAYERDIR}/recipes/*/*.bb ${LAYERDIR}/recipes/*/*.bbappend ${LAYERDIR}/recipes-*/*/*.bb ${LAYERDIR}/recipes-*/*/*.bbappend"
BBPATH .= ":${LAYERDIR}"
BBFILE_COLLECTIONS += "msm"
BBFILE_PRIORITY_msm = "10"
BBFILE_PATTERN_msm := "^${LAYERDIR}/"

# Tools needed on the build host for usage within build tasks by recipes of this layer.
HOSTTOOLS_NONFATAL += "xgettext msgmerge msgfmt gmsgfmt java zip"

BBMASK_append = " ${@bb.utils.contains('BBLAYERS', 'meta-virtualization', '', './recipes-containers/', d)}"
BBMASK_append = " ${@bb.utils.contains('BBLAYERS', 'meta-virtualization', '', './recipes-devtools/python/python3-dockerpty_%.bbappend', d)}"
```

## poky/meta-qti-bsp/conf/machine/include/mdm9650.inc
```bitbake
BASEMACHINE ?= "mdm9650"
require conf/machine/include/basemachine.inc

SOC_FAMILY ?= "mdm9x50"
include conf/machine/include/soc-family.inc

# Pull in security flags
require ${COREBASE}/meta-qti-bsp/conf/distro/include/security_flags.inc

# Enable floating-point ABI to Hard-float
#DEFAULTTUNE = "cortexa8hf-neon"

include conf/machine/include/tune-cortexa8.inc

PREFERRED_PROVIDER_virtual/kernel = "linux-msm"
PREFERRED_VERSION_linux-msm = "4.9"

BBMASK = ".*/*/recipes-devtools/mtd/"

MACHINE_DISPLAY_WIDTH_PIXELS ?= "480"
MACHINE_DISPLAY_HEIGHT_PIXELS ?= "640"

SERIAL_CONSOLE ?= "${@['', '115200 ttyMSM0'][d.getVar('VARIANT', True) == ('' or 'debug')]}"

DISTRO ?= "mdm"

MACHINE_FEATURES += "kernel26 keyboard ipa-offload"

PAGE_SIZE ?= '4096'

# Max supported inodes
EXTRA_IMAGECMD ?= "-N 2048"

#UBINIZE Args
UBINIZE_ARGS ?= "-m 4096 -p 256KiB -s 4096"
#MKUBIFS Args
MKUBIFS_ARGS ?= "-m 4096 -e 253952 -c 2146 -F"
#Volume sizes
SYSTEM_VOLUME_SIZE ?= "90MiB"
CACHE_VOLUME_SIZE ?= "70MiB"
SYSTEMRW_VOLUME_SIZE ?= "6MiB"

# Sizes for EXT4 (in bytes)
SYSTEM_SIZE_EXT4 ?= "200000000"
SYSTEMRW_SIZE_EXT4 ?= "8388608"
USERDATA_SIZE_EXT4 ?= "2000000000"
CACHE_SIZE_EXT4 ?= "80000000"

#Enable SDK feature
#SDK_IMAGE ?= "1"

# Formats of root filesystem images. 
IMAGE_FSTYPES += "ext4 ubi"
```

## poky/meta-qti-bsp/conf/machine/include/msm8909.inc
```bitbake
BASEMACHINE ?= "msm8909"
require conf/machine/include/basemachine.inc

SOC_FAMILY ?= "msm8909"
include conf/machine/include/soc-family.inc

# Pull in security flags
require ${COREBASE}/meta-qti-bsp/conf/distro/include/security_flags.inc

DEFAULTTUNE ?= "armv7ahf-neon"

include conf/machine/include/tune-cortexa7.inc

PREFERRED_PROVIDER_virtual/kernel = "linux-msm"
PREFERRED_VERSION_linux-msm = "3.18"

MACHINE_DISPLAY_WIDTH_PIXELS ?= "480"
MACHINE_DISPLAY_HEIGHT_PIXELS ?= "640"

SERIAL_CONSOLE ?= "${@['', '115200 ttyHSL0'][d.getVar('VARIANT', True) == ('' or 'debug')]}"

DISTRO ?= "msm"

DISTRO_FEATURES += "persist-image"

MACHINE_FEATURES += "kernel26 keyboard"

PAGE_SIZE ?= '4096'

# Max supported inodes
EXTRA_IMAGECMD ?= "-N 2048"

# Sizes for EXT4 (in bytes)
SYSTEM_SIZE_EXT4 ?= "1610613760"
SYSTEMRW_SIZE_EXT4 ?= "8388608"
USERDATA_SIZE_EXT4 ?= "4755012608"
CACHE_SIZE_EXT4 ?= "536870912"
RECOVERYFS_SIZE_EXT4 ?= "268435456"

#Enable Recovery image generation
RECOVERY_IMAGE ?= "1"

# Formats of root filesystem images.
IMAGE_FSTYPES += "ext4"

#Enable SDK feature
# SDK_IMAGE ?= "1"
```

## poky/meta-qti-bsp/conf/machine/include/sdx20.inc
```bitbake
BASEMACHINE ?= "sdx20"
require conf/machine/include/basemachine.inc

SOC_FAMILY ?= "mdm9x50"
include conf/machine/include/soc-family.inc

# Pull in security flags
require ${COREBASE}/meta-qti-bsp/conf/distro/include/security_flags.inc

include conf/machine/include/tune-cortexa8.inc

PREFERRED_PROVIDER_virtual/kernel = "linux-msm"
PREFERRED_VERSION_linux-msm = "3.18"

BBMASK = ".*/*/recipes-devtools/mtd/"

MACHINE_DISPLAY_WIDTH_PIXELS ?= "480"
MACHINE_DISPLAY_HEIGHT_PIXELS ?= "640"

SERIAL_CONSOLE ?= "${@['', '115200 ttyHSL0'][d.getVar('VARIANT', True) == ('' or 'debug')]}"

DISTRO ?= "mdm"

MACHINE_FEATURES += "kernel26 keyboard"

PAGE_SIZE ?= '4096'

# Max supported inodes
EXTRA_IMAGECMD ?= "-N 2048"

#UBINIZE Args
UBINIZE_ARGS ?= "-m 4096 -p 256KiB -s 4096"
#MKUBIFS Args
MKUBIFS_ARGS ?= "-m 4096 -e 253952 -c 2146 -F"
#Volume sizes
SYSTEM_VOLUME_SIZE ?= "90MiB"
#cache size to hold Full OTA update package, in case of incremental update
#it can be reduced to 53MB (need to upgrade apps & modem separately)
CACHE_VOLUME_SIZE ?= "96MiB"
SYSTEMRW_VOLUME_SIZE ?= "6MiB"

# Sizes for EXT4 (in bytes)
SYSTEM_SIZE_EXT4 ?= "200000000"
SYSTEMRW_SIZE_EXT4 ?= "8388608"
USERDATA_SIZE_EXT4 ?= "2000000000"
CACHE_SIZE_EXT4 ?= "80000000"


# Formats of root filesystem images.
IMAGE_FSTYPES += "ext4 ubi"
```

## poky/meta-qti-bsp/conf/machine/mdm9650.conf
```bitbake
#@TYPE: Machine
#@NAME: MDMCALIFORNIUM
#@DESCRIPTION: Machine configuration for QTI MDMCALIFORNIUM MTP

require conf/machine/include/mdm9650.inc

KERNEL_IMAGETYPE = "zImage"
KERNEL_DTS_NAME = "mdm9650"
KERNEL_BASE = "0x80000000"
KERNEL_TAGS_OFFSET = "0x82000000"

KERNEL_CONFIG = "${@['mdm-perf_defconfig', 'mdm_defconfig'][d.getVar('VARIANT', True) == ('' or 'debug')]}"

KERNEL_CMD_PARAMS = "noinitrd ro console=ttyMSM0,115200,n8 androidboot.hardware=qcom ehci-hcd.park=3 msm_rtb.filter=0x37 lpm_levels.sleep_disabled=1 earlycon=msm_serial_dm,0x78b1000"
KERNEL_CMD_PARAMS_remove = "${@bb.utils.contains_any('VARIANT', 'perf user', 'console=ttyMSM0,115200,n8', '', d)}"

#Enable Recovery image generation
RECOVERY_IMAGE = "1"
```

## poky/meta-qti-bsp/conf/machine/qcs403-som2.conf
```bitbake
#@TYPE: Machine
#@NAME: SOM2-QCS403
#@DESCRIPTION: Machine configuration for QTI SOM2-QCS403
require conf/machine/include/qcs40x.inc
# NAND TARGET TO SUPPORT 32-bit kernel
DISTRO = "qsap"
DISTRO_FEATURES += "nand-boot"
PAGE_SIZE ?= '4096'
USR_IMAGE_BASENAME       = "${BASEMACHINE}-usrfs"
OUTPUT_FILE_FINAL_UBI    = "${DEPLOY_DIR_IMAGE}/${BASEMACHINE}-sysfs.ubi"
# Max supported inodes
EXTRA_IMAGECMD ?= "-N 2048"
#UBINIZE Args
UBINIZE_ARGS ?= "-m 4096 -p 256KiB -s 4096"
#MKUBIFS Args
MKUBIFS_ARGS ?= "-m 4096 -e 253952 -c 2146 -F"
#Volume sizes
SYSTEM_VOLUME_SIZE ?= "150MiB"
CACHE_VOLUME_SIZE ?= "20MiB"
SYSTEMRW_VOLUME_SIZE ?= "6MiB"
PERSIST_VOLUME_SIZE ?= "12MiB"
# Formats of root filesystem images.
IMAGE_FSTYPES += "ubi"

# enable audio as a loadable kernel module
DISTRO_FEATURES_append = " audio-dlkm"
DISTRO_FEATURES_append = " persist-volume"
DEFAULTTUNE = "armv7ahf-neon"
MKUBIFS_PERSIST_ARGS = "-m 4096 -e 253952 -c 2146 -F"
RECOVERY_IMAGE = "0"

KERNEL_IMAGETYPE = "zImage-dtb"

#Need for compiling UEFI for aarch64
require conf/multilib.conf
MULTILIBS = "multilib:lib64"
DEFAULTTUNE_virtclass-multilib-lib64 = "aarch64"

PREFERRED_PROVIDER_virtual/libgles1 = "adreno"
PREFERRED_PROVIDER_virtual/libgles2 = "adreno"
PREFERRED_PROVIDER_virtual/egl      = "adreno"

# Flag to Enable QPermissions
QPERMISSIONS_ENABLE = "1"

QPERM_FILE_pn-start-script-ab-slot-util = "${bindir}/getslotsuffix:root:system"
QPERM_FILE_pn-system-core = "${sysconfdir}/build.prop:leprop:leprop ${sysconfdir}/initscripts/logd:logd:logd"
QPERM_FILE_pn-system-prop = "/build.prop:leprop:leprop"
```

## poky/meta-qti-bsp/conf/machine/qcs405-som1.conf
```bitbake
#@TYPE: Machine
#@NAME: SOM1-QCS405
#@DESCRIPTION: Machine configuration for QTI SOM1-QCS405
require conf/machine/include/qcs40x.inc
# EMMC TARGET TO SUPPORT 64-bit kernel
DISTRO = "qsap"
DEFAULTTUNE = "aarch64"

# Sizes for EXT4 (in bytes)
SYSTEM_SIZE_EXT4 ?= "681574400"
SYSTEMRW_SIZE_EXT4 ?= "8388608"
USERDATA_SIZE_EXT4 ?= "2000000000"
CACHE_SIZE_EXT4 ?= "80000000"

# enable audio as a loadable kernel module
DISTRO_FEATURES_append = " audio-dlkm"

#enable selinux
DISTRO_FEATURES_append = " selinux"
DEFAULT_ENFORCING = "enforcing"

#Enable verity feature
DISTRO_FEATURES += "dm-verity"

# Formats of root filesystem images.
IMAGE_FSTYPES += "ext4"
RECOVERY_IMAGE = "0"

KERNEL_IMAGETYPE = "Image.gz-dtb"
IMAGE_EXT4_EXTRA_OPTIONS = "${@bb.utils.contains('DISTRO_FEATURES','ro-rootfs',' -J -b 4096 ','',d)}"
DISTRO_FEATURES += "persist-image"
require conf/multilib.conf
MULTILIBS = "multilib:lib32"
DEFAULTTUNE_virtclass-multilib-lib32 = "armv7ahf-neon"
TARGET_VENDOR_virtclass-multilib-lib32="-oe"

PREFERRED_PROVIDER_virtual/libgles1 = "adreno"
PREFERRED_PROVIDER_virtual/libgles2 = "adreno"
PREFERRED_PROVIDER_virtual/egl      = "adreno"

DISTRO_FEATURES += "ab-boot-support"

# Flag to Enable QPermissions
QPERMISSIONS_ENABLE = "1"

QPERM_FILE_pn-start-script-ab-slot-util = "${bindir}/getslotsuffix:root:system"
QPERM_FILE_pn-system-core = "${sysconfdir}/build.prop:leprop:leprop ${sysconfdir}/initscripts/logd:logd:logd"
QPERM_FILE_pn-system-prop = "/build.prop:leprop:leprop"

PREFERRED_PROVIDER_virtual/wpebackend = "wpebackend-rdk"
```
