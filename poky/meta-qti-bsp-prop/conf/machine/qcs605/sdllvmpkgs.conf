## poky/meta-qti-bsp/conf/machine/qcs605-32.conf
```bitbake
#@TYPE: Machine
#@NAME: QCS605-32
#@DESCRIPTION: Machine configuration for QTI QCS605 32bit

require conf/machine/include/qcs605.inc

DEFAULTTUNE = "armv7ahf-neon"

KERNEL_IMAGETYPE = "zImage-dtb"

KERNEL_DTS_NAME = "qcs605"
KERNEL_BASE = "0x80000000"
KERNEL_TAGS_OFFSET = "0x81900000"

KERNEL_CONFIG = "${@['sdm670-perf_defconfig', 'sdm670_defconfig'][d.getVar('VARIANT', True) == ('' or 'debug')]}"

KERNEL_CMD_PARAMS = "console=ttyMSM0,115200n8 earlycon=msm_geni_serial,0xA84000 androidboot.hardware=qcom androidboot.console=ttyMSM0 video=vfb:640x400,bpp=32,memsize=3072000 msm_rtb.filter=0x237 ehci-hcd.park=3 lpm_levels.sleep_disabled=1 service_locator.enable=1 firmware_class.path=/lib/firmware/updates rootfstype=ext4"

# Remove console related parameters for non-debug builds.
KERNEL_CMD_PARAMS_remove = "${@bb.utils.contains_any('VARIANT', 'perf user', 'console=ttyMSM0,115200n8', '', d)}"
KERNEL_CMD_PARAMS_remove = "${@bb.utils.contains_any('VARIANT', 'perf user', 'earlycon=msm_geni_serial,0xA84000', '', d)}"
KERNEL_CMD_PARAMS_remove = "${@bb.utils.contains_any('VARIANT', 'perf user', 'androidboot.console=ttyMSM0', '', d)}"
KERNEL_CMD_PARAMS_append = "${@bb.utils.contains_any('VARIANT', 'perf user', ' quiet systemd.log_target=null', '', d)}"

# readonly-rootfs
DISTRO_FEATURES_append = " ro-rootfs"

# Generate persist image
DISTRO_FEATURES += "persist-image"

#Enable virtualization support on LE platform
#DISTRO_FEATURES_append = " virtualization"

# Use systemd init manager.
DISTRO_FEATURES_remove = "sysvinit"
DISTRO_FEATURES_append = " systemd"
DISTRO_FEATURES_BACKFILL_CONSIDERED += "sysvinit"
VIRTUAL-RUNTIME_dev_manager = "udev"
VIRTUAL-RUNTIME_init_manager = "systemd"

#enable selinux
DISTRO_FEATURES_append = " selinux"
DEFAULT_ENFORCING = "enforcing"

#Enable verity feature
DISTRO_FEATURES += "dm-verity"

# enable audio as a loadable kernel module
DISTRO_FEATURES_append = " audio-dlkm"

# Change Image features for systemd.
IMAGE_DEV_MANAGER = "udev"
IMAGE_INIT_MANAGER = "systemd"
IMAGE_INITSCRIPTS = ""

# Disable journalling for RO rootfs. Set the block size to 1024.
IMAGE_EXT4_EXTRA_OPTIONS = "${@bb.utils.contains('DISTRO_FEATURES','ro-rootfs',' -J -b 4096 ','',d)}"

# Multilib configuration
# This sets any packages preprended with lib64- to be built with
# the aarch64 tuning (64 bit) instead of 64 bit aarch.
# Need for compiling UEFI for aarch64
require conf/multilib.conf
MULTILIBS = "multilib:lib64"
DEFAULTTUNE_virtclass-multilib-lib64 = "aarch64"
TARGET_VENDOR_virtclass-multilib-lib64="-oe"

# Flag to Enable QPermissions
QPERMISSIONS_ENABLE = "1"

QPERM_FILE_pn-start-script-ab-slot-util = "${bindir}/getslotsuffix:root:system"
QPERM_FILE_pn-system-core = "${sysconfdir}/build.prop:leprop:leprop ${sysconfdir}/initscripts/logd:logd:logd"
QPERM_FILE_pn-system-prop = "/build.prop:leprop:leprop"
```

## poky/meta-qti-bsp/conf/machine/sdmsteppe.conf
```bitbake
#@TYPE: Machine
#@NAME: sdmsteppe
#@DESCRIPTION: Machine configuration for QTI sdmsteppe 32bit

require  ${COREBASE}/meta-qti-bsp/conf/machine/sdm-generic32.conf

# Pull in security flags
require ${COREBASE}/meta-qti-bsp/conf/distro/include/security_flags.inc

SOC_FAMILY = "sdm670"

BASEMACHINE = "sdmsteppe"

DEFAULTTUNE = "armv7ahf-neon"

PREFERRED_PROVIDER_virtual/kernel = "linux-msm"
PREFERRED_VERSION_linux-msm = "4.14"

# Kernel to build for a different arch than default tune
TARGET_KERNEL_ARCH = "aarch64"

KERNEL_DTS_NAME = "sm6150-qrd"
KERNEL_BASE = "0x80000000"
KERNEL_TAGS_OFFSET = "0x81E00000"
KERNEL_IMAGETYPE = "Image.gz-dtb"
KERNEL_CONFIG = "${@['vendor/sdmsteppe-perf_defconfig', 'vendor/sdmsteppe_defconfig'][d.getVar('VARIANT', True) == ('' or 'debug')]}"

# Defined 64bit multilib environment to setup toolchain to compile 64bit kernel
require conf/multilib.conf
MULTILIBS = "multilib:lib64"
DEFAULTTUNE_virtclass-multilib-lib64 = "aarch64"
TARGET_VENDOR_virtclass-multilib-lib64="-oe"

# Enable selinux
DISTRO_FEATURES_append = " selinux"
DEFAULT_ENFORCING = "enforcing"

# enable audio as a loadable kernel module
DISTRO_FEATURES_append = " audio-dlkm"

# readonly-rootfs
DISTRO_FEATURES_append = " ro-rootfs"

# Support A/B partition scheme
DISTRO_FEATURES += "ab-boot-support"

#Disable journalling for RO rootfs. Set the block size to 4096.
IMAGE_EXT4_EXTRA_OPTIONS = "${@bb.utils.contains('DISTRO_FEATURES','ro-rootfs',' -J -b 4096 ','',d)}"

# Flag to Enable QPermissions
QPERMISSIONS_ENABLE = "1"

QPERM_FILE_pn-start-script-ab-slot-util = "${bindir}/getslotsuffix:root:system"
QPERM_FILE_pn-system-core = "${sysconfdir}/build.prop:leprop:leprop ${sysconfdir}/initscripts/logd:logd:logd"
QPERM_FILE_pn-system-prop = "/build.prop:leprop:leprop"


# Userspace needs below given macro to support libion after kernel 4.12.
TARGET_CFLAGS += " -DTARGET_ION_ABI_VERSION=2"
TARGET_CXXFLAGS += " -DTARGET_ION_ABI_VERSION=2"

PREFERRED_PROVIDER_virtual/libgles1 = "adreno"
PREFERRED_PROVIDER_virtual/libgles2 = "adreno"
PREFERRED_PROVIDER_virtual/egl      = "adreno"
```

## poky/meta-qti-bsp/conf/machine/sdx20.conf
```bitbake
#@TYPE: Machine
#@NAME: SDX20
#@DESCRIPTION: Machine configuration for QTI SDX20

require conf/machine/include/sdx20.inc

KERNEL_DTS_NAME = "sdx20"
KERNEL_BASE = "0x80000000"
KERNEL_TAGS_OFFSET = "0x82000000"

KERNEL_CONFIG = "${@['sdx-perf_defconfig', 'sdx_defconfig'][d.getVar('VARIANT', True) == ('' or 'debug')]}"

KERNEL_CMD_PARAMS = "noinitrd ro console=ttyHSL0,115200,n8 androidboot.hardware=qcom ehci-hcd.park=3 msm_rtb.filter=0x37 lpm_levels.sleep_disabled=1 earlycon=msm_hsl_uart,0x78b1000"
KERNEL_CMD_PARAMS_remove = "${@bb.utils.contains_any('VARIANT', 'perf user', 'console=ttyHSL0,115200,n8', '', d)}"

#Enable Recovery image generation
RECOVERY_IMAGE = "1"
```

## poky/meta-qti-bt-prop/conf/layer.conf
```bitbake
BBFILES += "${LAYERDIR}/recipes/*/*.bb ${LAYERDIR}/recipes/*/*.bbappend ${LAYERDIR}/recipes-*/*/*.bb ${LAYERDIR}/recipes-products/images/*.bbappend"
BBPATH .= ":${LAYERDIR}"
BBFILE_COLLECTIONS += "bt-prop"
BBFILE_PRIORITY_bt-prop = "17"
BBFILE_PATTERN_bt-prop := "^${LAYERDIR}/"
```
