## poky/meta-qti-camera-prop/conf/layer.conf
```bitbake
BBFILES += "${LAYERDIR}/recipes/*/*.bb ${LAYERDIR}/recipes/*/*.bbappend ${LAYERDIR}/recipes-*/*/*.bb ${LAYERDIR}/recipes-products/images/*.bbappend"
BBPATH .= ":${LAYERDIR}"
BBFILE_COLLECTIONS += "qti_cam_prop"
BBFILE_PRIORITY_qti_cam_prop =  "17"
BBFILE_PATTERN_qti_cam_prop := "^${LAYERDIR}/"
```

## poky/meta-qti-core-prop/conf/layer.conf
```bitbake
BBFILES += "${LAYERDIR}/recipes/*/*.bb ${LAYERDIR}/recipes/*/*.bbappend ${LAYERDIR}/recipes-*/*/*.bb ${LAYERDIR}/recipes-products/images/*.bbappend"
BBPATH .= ":${LAYERDIR}"
BBFILE_COLLECTIONS += "core-prop"
BBFILE_PRIORITY_core-prop = "17"
BBFILE_PATTERN_core-prop := "^${LAYERDIR}/"
```

## poky/meta-qti-data-prop/conf/layer.conf
```bitbake
BBFILES += "${LAYERDIR}/recipes/*/*.bb ${LAYERDIR}/recipes/*/*.bbappend ${LAYERDIR}/recipes-*/*/*.bb ${LAYERDIR}/recipes-products/images/*.bbappend"
BBPATH .= ":${LAYERDIR}"
BBFILE_COLLECTIONS += "qcom-data"
BBFILE_PRIORITY_qcom-data = "17"
BBFILE_PATTERN_qcom-data := "^${LAYERDIR}/"
```

## poky/meta-qti-display-prop/conf/layer.conf
```bitbake
BBFILES += "${LAYERDIR}/recipes/*/*.bb ${LAYERDIR}/recipes/*/*.bbappend ${LAYERDIR}/recipes-*/*/*.bb ${LAYERDIR}/recipes-products/images/*.bbappend"
BBPATH .= ":${LAYERDIR}"
BBFILE_COLLECTIONS += "msm"
BBFILE_PRIORITY_msm =  "15"
BBFILE_PATTERN_msm := "^${LAYERDIR}/"
```

## poky/meta-qti-gst-prop/conf/layer.conf
```bitbake
BBFILES += "${LAYERDIR}/recipes/*/*.bb ${LAYERDIR}/recipes/*/*.bbappend ${LAYERDIR}/recipes-*/*/*.bb ${LAYERDIR}/recipes-*/*/*.bbappend"
BBPATH .= ":${LAYERDIR}"
BBFILE_COLLECTIONS += "gst-prop"
BBFILE_PRIORITY_gst-prop = "17"
BBFILE_PATTERN_gst-prop := "^${LAYERDIR}/"
```

## poky/meta-qti-gst/conf/layer.conf
```bitbake
BBFILES += "${LAYERDIR}/recipes/*/*.bb ${LAYERDIR}/recipes/*/*.bbappend ${LAYERDIR}/recipes-*/*/*.bb ${LAYERDIR}/recipes-*/*/*.bbappend"
BBPATH .= ":${LAYERDIR}"
BBFILE_COLLECTIONS += "gst"
BBFILE_PATTERN_gst := "^${LAYERDIR}/"
BBFILE_PRIORITY_gst = "17"
# msm = meta-qti-bsp
LAYERDEPENDS_gst = "msm"
```

## poky/meta-qti-location-prop/conf/layer.conf
```bitbake
BBFILES += "${LAYERDIR}/recipes/*/*.bb ${LAYERDIR}/recipes/*/*.bbappend ${LAYERDIR}/recipes-*/*/*.bb ${LAYERDIR}/recipes-products/images/*.bbappend"
BBPATH .= ":${LAYERDIR}"
BBFILE_COLLECTIONS += "location-prop"
BBFILE_PRIORITY_location-prop = "17"
BBFILE_PATTERN_location-prop := "^${LAYERDIR}/"
```

## poky/meta-qti-qsap-prop/conf/layer.conf
```bitbake
BBFILES += "${LAYERDIR}/recipes/*/*.bb ${LAYERDIR}/recipes/*/*.bbappend ${LAYERDIR}/recipes-*/*/*.bb ${LAYERDIR}/recipes-*/*/*.bbappend"
BBPATH .= ":${LAYERDIR}"
BBFILE_COLLECTIONS += "qsap-prop"
BBFILE_PRIORITY_qsap-prop = "17"
BBFILE_PATTERN_qsap-prop := "^${LAYERDIR}/"
LAYERDEPENDS_qsap-prop = "gst-prop"
```

## poky/meta-qti-qzhost-prop/conf/layer.conf
```bitbake
BBFILES += "${LAYERDIR}/recipes/*/*.bb ${LAYERDIR}/recipes/*/*.bbappend ${LAYERDIR}/recipes-*/*/*.bb ${LAYERDIR}/recipes-products/images/*.bbappend"
BBPATH .= ":${LAYERDIR}"
BBFILE_COLLECTIONS += "qzhost"
BBFILE_PRIORITY_qzhost = "12"
BBFILE_PATTERN_qzhost := "^${LAYERDIR}/"
```

## poky/meta-qti-ros/conf/layer.conf
```bitbake
# Look for bb and bbappends in the layer only if DISTRO is quec-smart-ros
BBFILES +="${@base_contains('DISTRO', 'quec-smart-ros'," ${LAYERDIR}/recipes*/*/*.bb ${LAYERDIR}/recipes*/*/*.bbappend ", '', d)}"
BBPATH .= ":${LAYERDIR}"
BBFILE_COLLECTIONS += "msm"
BBFILE_PRIORITY_msm = "12"
BBFILE_PATTERN_msm := "^${LAYERDIR}/"
```

## poky/meta-qti-sepolicy/conf/layer.conf
```bitbake
BBFILES += "${LAYERDIR}/recipes/*/*.bb ${LAYERDIR}/recipes/*/*.bbappend ${LAYERDIR}/recipes-*/*/*.bb ${LAYERDIR}/recipes-*/*/*.bbappend"
BBPATH .= ":${LAYERDIR}"
BBFILE_COLLECTIONS += "sepolicy"
BBFILE_PRIORITY_sepolicy = "11"
BBFILE_PATTERN_sepolicy := "^${LAYERDIR}/"

# A similar recipe is provided by android_compat. If selinux is fully enabled,
#  then use the version from meta-selinux. Otherwise, mask the meta-selinux
#  version and fallback to the android_compat version.
BBMASK_append = "${@bb.utils.contains("DISTRO_FEATURES", "selinux", ".*/*/recipes-security/libselinux/", "./recipes-security/selinux/libselinux/", d)}"

PREFERRED_PROVIDER_virtual/refpolicy = "refpolicy-mls"
PREFERRED_VERSION_refpolicy-mls = "2.20170204"
```

## poky/meta-qti-ss-mgr-prop/conf/layer.conf
```bitbake
BBFILES += "${LAYERDIR}/recipes/*/*.bb ${LAYERDIR}/recipes/*/*.bbappend ${LAYERDIR}/recipes-*/*/*.bb ${LAYERDIR}/recipes-products/images/*.bbappend"
BBPATH .= ":${LAYERDIR}"
BBFILE_COLLECTIONS += "ss-mgr-prop"
BBFILE_PRIORITY_ss-mgr-prop = "17"
BBFILE_PATTERN_ss-mgr-prop := "^${LAYERDIR}/"
```

## poky/meta-qti-ss-mgr/conf/layer.conf
```bitbake
BBFILES += "${LAYERDIR}/recipes/*/*.bb ${LAYERDIR}/recipes/*/*.bbappend ${LAYERDIR}/recipes-*/*/*.bb ${LAYERDIR}/recipes-products/images/*.bbappend"
BBPATH .= ":${LAYERDIR}"
BBFILE_COLLECTIONS += "ss-mgr"
BBFILE_PRIORITY_ss-mgr = "12"
BBFILE_PATTERN_ss-mgr := "^${LAYERDIR}/"
```

## poky/meta-qti-video/conf/layer.conf
```bitbake
BBFILES += "${LAYERDIR}/recipes/*/*.bb ${LAYERDIR}/recipes/*/*.bbappend ${LAYERDIR}/recipes-*/*/*.bb ${LAYERDIR}/recipes-*/*/*.bbappend"
BBPATH .= ":${LAYERDIR}"
BBFILE_COLLECTIONS += "video"
BBFILE_PRIORITY_video = "12"
BBFILE_PATTERN_video := "^${LAYERDIR}/"
```

## poky/meta-qti-wlan-prop/conf/layer.conf
```bitbake
BBFILES += "${LAYERDIR}/recipes/*/*.bb ${LAYERDIR}/recipes/*/*.bbappend ${LAYERDIR}/recipes-*/*/*.bb ${LAYERDIR}/recipes-products/images/*.bbappend"
BBPATH .= ":${LAYERDIR}"
BBFILE_COLLECTIONS += "qti-wlan"
BBFILE_PRIORITY_qti-wlan = "17"
BBFILE_PATTERN_qti-wlan := "^${LAYERDIR}/"
```

## poky/meta-quectel-app/conf/layer.conf
```bitbake
# We have a conf and classes directory, add to BBPATH
BBPATH .= ":${LAYERDIR}"

# We have recipes-* directories, add to BBFILES
BBFILES += "${LAYERDIR}/recipes/*/*.bb ${LAYERDIR}/recipes/*.bb ${LAYERDIR}/recipes/*/*.bbappend ${LAYERDIR}/recipes-*/*/*.bb ${LAYERDIR}/recipes-products/images/*.bbappend"

BBFILE_COLLECTIONS += "meta-quectel-app"
BBFILE_PATTERN_meta-quectel-app = "^${LAYERDIR}/"
BBFILE_PRIORITY_meta-quectel-app = "6"
```

## poky/meta-quectel-core/conf/layer.conf
```bitbake
# We have a conf and classes directory, add to BBPATH
BBPATH .= ":${LAYERDIR}"

# We have recipes-* directories, add to BBFILES
BBFILES += "${LAYERDIR}/recipes/*/*.bb ${LAYERDIR}/recipes/*.bb ${LAYERDIR}/recipes/*/*.bbappend ${LAYERDIR}/recipes-*/*/*.bb ${LAYERDIR}/recipes-products/images/*.bbappend"

BBFILE_COLLECTIONS += "quectel-core"
BBFILE_PATTERN_quectel-core = "^${LAYERDIR}/"
BBFILE_PRIORITY_quectel-core = "6"
```

## poky/meta-ros/conf/layer.conf
```bitbake
# We have a conf and classes directory, append to BBPATH
BBPATH .= ":${LAYERDIR}"

# Look for bb and bbappends in the layer only if DISTRO is quec-smart-ros
BBFILES +="${@base_contains('DISTRO', 'quec-smart-ros'," ${LAYERDIR}/recipes-*/*/*.bb ${LAYERDIR}/recipes-*/*/*.bbappend ", '', d)}"
BBFILES +="${@base_contains('DISTRO', 'quec-smart'," ${LAYERDIR}/recipes-extended/libcryptopp/libcryptopp_5.6.4.bb ${LAYERDIR}/recipes-extended/qhull/qhull_2012.1.bb ", '', d)}"

BBFILE_COLLECTIONS += "ros-layer"
BBFILE_PATTERN_ros-layer := "^${LAYERDIR}/"
BBFILE_PRIORITY_ros-layer = "7"

LICENSE_PATH += "${LAYERDIR}/licenses"

ROSDISTRO := "indigo"
```

## poky/meta-selinux/conf/distro/oe-selinux.conf
```bitbake
DISTRO = "oe-selinux"
DISTROOVERRIDES .= ":selinux"

DISTRO_FEATURES_append = " acl xattr pam selinux"
PREFERRED_PROVIDER_virtual/refpolicy ?= "refpolicy-mls"
```
